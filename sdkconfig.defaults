## sdkconfig.defaults
```kconfig
CONFIG_PARTITION_TABLE_CUSTOM=y
CONFIG_PARTITION_TABLE_CUSTOM_FILENAME="partitions.csv"
CONFIG_NVS_ENCRYPTION=n
CONFIG_LWIP_TCP_KEEPALIVE=y
CONFIG_LOG_DEFAULT_LEVEL_INFO=y
CONFIG_MDNS_MAX_SERVICES=4
CONFIG_LWIP_DHCP_GET_NTP_SRV=y
CONFIG_ESP_TLS_USING_MBEDTLS=y
CONFIG_ESP_HTTPS_OTA_DECRYPT_CB=n
CONFIG_MQTT_PROTOCOL_311=y
CONFIG_MQTT_TRANSPORT_SSL=n
CONFIG_MQTT_TRANSPORT_WEBSOCKET=n
CONFIG_ESP_TASK_WDT_EN=y
CONFIG_ESP_TASK_WDT_TIMEOUT_S=15
CONFIG_ESP_TASK_WDT_PANIC=y
```
